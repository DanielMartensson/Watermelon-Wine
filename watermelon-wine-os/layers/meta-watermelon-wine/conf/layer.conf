## watermelon-wine-os/layers/meta-watermelon-wine/conf/layer.conf
```bitbake
# Add conf/ and classes/ to BBPATH
BBPATH .= ":${LAYERDIR}"

# Add recipes
BBFILES += "${LAYERDIR}/recipes-*/*/*.bb \
            ${LAYERDIR}/recipes-*/*/*.bbappend"

# Register layer
BBFILE_COLLECTIONS += "watermelon-wine"
BBFILE_PATTERN_watermelon-wine = "^${LAYERDIR}/"
BBFILE_PRIORITY_watermelon-wine = "9"

# Dependencies
LAYERDEPENDS_watermelon-wine = "stm-st-stm32mp-mx"

# Yocto release compatibility
LAYERSERIES_COMPAT_watermelon-wine = "scarthgap"
```
